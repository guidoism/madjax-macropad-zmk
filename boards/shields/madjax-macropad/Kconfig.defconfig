## boards/shields/madjax-macropad/Kconfig.defconfig
```kconfig
if SHIELD_MADJAX_MACROPAD

# Name must be less than 16 characters long!
config ZMK_KEYBOARD_NAME
    default "MadJax Macropad"

endif
```

## boards/shields/madjax-macropad/Kconfig.shield
```kconfig
# No whitespace after the comma or in your keyboard name!
config SHIELD_MADJAX_MACROPAD
    def_bool $(shields_list_contains,madjax-macropad)
```
